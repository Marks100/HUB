; HUB project - STM32F103C8T6
; Flash BM + APP combined image and open a debug session.
;
; Flash layout (128 KB total - confirmed via live F_SIZE register read at 0x1FFFF7E0; this "C8"
; part is physically 128 KB silicon, a known STM32F103 binning quirk):
;   BM  : 0x08000000 - 0x080027FF  10 KB
;   FBL : 0x08002800 - 0x08007FFF  22 KB
;   APP : 0x08008000 - 0x0801F7FF  94 KB  (vectors at 0x08008100)
;   NVM : 0x0801F800 - 0x0801FFFF   2 KB  (reserved - fixed by NVM_BASE_ADDRESS/NVM_TOTAL_SIZE in
;                                          Common_Src/PROJ_CONFIG/PROJ_config.h. NVM_GEN2's two
;                                          flip-flop partitions - A at 0x0801F800, B at 0x0801FC00,
;                                          shared by FBL and APP. Exactly one carries a committed
;                                          16-byte header; dump both and the higher seq wins. See
;                                          xCOMMON_MODULES/Src/NVM_GEN2/README.md)
;
; NOTE: SYStem.CPU STM32F103CB below (not C8) - C8's device-database entry in Trace32 selects a
; flash algorithm (~~/demo/arm/flash/stm32f10x.cmm, in the Trace32 install tree, not this repo)
; that hardcodes the nominal 64 KB erase/program range and silently doesn't program past
; 0x0800FFFF. APP spans well past that boundary, so with C8 selected most of APP's actual code
; stays as stale/erased flash even though FLASH.ReProgram reports success. CB is the 128 KB part
; number and its flash algorithm covers the real physical size of this "C8" part (see the binning
; quirk note above) - use it for any script that actually programs flash.
;
; BM is no longer an unconditional jump to APP - it validates the APP header's presence pattern
; and hardware CRC (xCOMMON_MODULES/Src/BM/BM.c's BM_run()) before jumping, so "Go.direct app_main"
; below is no longer guaranteed to complete just because the flash succeeded. A breakpoint at
; BM_jump_to_fbl catches the failure path (bad CRC/presence - there is no FBL image to actually
; land in yet, so without this breakpoint a failed validation looks like Go just hanging, with no
; indication of why). Signature checking is currently disabled (signature_enabled = FALSE in
; BM/Src/bm_main.c - see its signature_verify_not_implemented()), so that path can't trap yet.
;
; Required environment variables:
;   LAUTERBACH_APP_EXE      path to APP/Build/APP.elf
;   LAUTERBACH_BM_EXE       path to BM/Build/BM.elf
;   LAUTERBACH_COMBINED_EXE path to APP/Build/BM_FBL_APP_combined.hex

&app_exe=OS.ENV("LAUTERBACH_APP_EXE")
&bm_exe=OS.ENV("LAUTERBACH_BM_EXE")
&fbl_exe=OS.ENV("LAUTERBACH_FBL_EXE")
&combined_hex=OS.ENV("LAUTERBACH_COMBINED_EXE")

; --------------------------------------------------------------------------------
; Connect
SYStem.RESet
SYStem.CPU STM32F103CB
SYStem.CONFIG.DEBUGPORTTYPE SWD
IF COMBIPROBE()||UTRACE()
(
  SYStem.CONFIG.CONNECTOR MIPI20T
)
SYStem.Option DUALPORT ON
SYStem.MemAccess DAP
SYStem.JtagClock 10MHz
SYStem.Option.IMASKHLL ON
SYStem.Option.IMASKASM ON
Trace.DISable
SYStem.Up

; --------------------------------------------------------------------------------
; Flash combined BM + APP image
DO ~~/demo/arm/flash/stm32f10x.cmm PREPAREONLY
FLASH.ReProgram ALL
Data.LOAD.auto &combined_hex
FLASH.ReProgram OFF

; --------------------------------------------------------------------------------
; Reset MCU after flashing, reconnect debugger
SYStem.Up

; --------------------------------------------------------------------------------
; Load debug symbols from both partitions (no reflash)
Data.LOAD.auto &app_exe /nocode /noclear
Data.LOAD.auto &bm_exe  /nocode /noclear
Data.LOAD.auto &fbl_exe /nocode /noclear


Mode.Hll

; Go.direct only stops at the address(es) given to it and ignores other breakpoints along the
; way - so catching BM's validation-failure path means giving Go.direct BM_jump_to_fbl as a
; second target, not a separate Break.Set (which Go.direct would just skip past). Runs through
; BM's validation, halts at whichever is reached first: app_main (accepted) or BM_jump_to_fbl
; (rejected - bad presence pattern or CRC mismatch, see BM_run() in xCOMMON_MODULES/Src/BM/BM.c).
WAIT !STATE.RUN()

; --------------------------------------------------------------------------------
; Open debug windows
List.auto
Frame.view
Register.view /SpotLight
setup.var.%Hex %Decimal %SpotLight %Index

Do ToolBar.men

ENDDO
