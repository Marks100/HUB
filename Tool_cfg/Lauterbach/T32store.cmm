// T32 Thu Jun 18 15:42:41 2026

B::

HISTory.SIZE 10.
HISTory.Set CMD "B::go"
HISTory.Set CMD "B::SYStem.Status"
HISTory.Set CMD "B::SYStem.Attach "
HISTory.Set CMD "B::SYStem.Mode NoDebug "
HISTory.Set CMD "B::IF Sys"
HISTory.Set CMD "B::PER.Set.simple AD:0x40065084 %Long 00000001"
HISTory.Set CMD "B::PER.Set.simple AD:0x4002C064 %Long 0x44444444"
HISTory.Set CMD "B::PER.Set.simple AD:0x4002C064 %Long 0x1234"
HISTory.Set CMD "B::PER.Set.simple AD:0x4002C064 %Long 0x00000001"
HISTory.Set CMD "B::PER.Set.simple AD:0x4002C064 %Long 0x01"
HISTory.Set CMD "B::PER.Set.simple AD:0x4002C064 %Long 0xAA"
HISTory.Set CMD "B::PER.Set.simple AD:0x4006A010 %Long 0x0F000034"
HISTory.Set CMD "B::PER.Set.simple AD:0x4006A018 %Long 0x000C0000"
HISTory.Set CMD "B::PER.Set.simple AD:0x4006A010 %Long 0x0F000034"
HISTory.Set CMD "B::V *pSem = 1"
HISTory.Set CMD "B::PER.Set.simple AD:0x4003A004 %Long 0x3444"
HISTory.Set CMD "B::PER.Set.simple AD:0x4003A004 %Long 0x03"
HISTory.Set CMD "B::PER.Set.Field AD:0x4003A004 %Long 0xFFFF 0xffff"
HISTory.Set CMD "B::PER.Set.simple AD:0x4003A004 %Long 0x06"
HISTory.Set CMD "B::PER.Set.simple AD:0x4003A004 %Long 0x01"
HISTory.Set CMD "B::PER.Set.simple AD:0x4003A004 %Long 0x00004"
HISTory.Set CMD "B::PER.Set.Field AD:0x4003A004 %Long 0xFFFF 0x04"
HISTory.Set CMD "B::PER.Set.simple AD:0x4003A004 %Long 0x04"
HISTory.Set CMD "B::PER.Set.Field AD:0x4003A004 %Long 0xFFFF 0x04"
HISTory.Set CMD "B::PER.Set.Field AD:0x4003A004 %Long 0xFFFF 0x03"
HISTory.Set CMD "B::PER.Set.Field AD:0x4003A004 %Long 0xFFFF 0x05"
HISTory.Set CMD "B::PER.Set.Field AD:0x4003A004 %Long 0xFFFF 0x04"
HISTory.Set CMD "B::PER.Set.Field AD:0x4003A008 %Long 0xFFFF 0x5555"
HISTory.Set CMD "B::PER.Set.Field AD:0x4003A008 %Long 0xFFFF 0x66"
HISTory.Set CMD "B::PER.Set.simple AD:0x4003A004 %Long 0x03"
HISTory.Set CMD "B::PER.Set.Field AD:0x4003A004 %Long 0xFFFF 0x03"
HISTory.Set CMD "B::PER.Set.Field AD:0x4003A008 %Long 0xFFFF 0x04"
HISTory.Set CMD "B::PER.Set.simple AD:0x4003A004 %Long 0x03"
HISTory.Set CMD "B::PER.Set.Field AD:0x4003A004 %Long 0xFFFF 0x04"
HISTory.Set CMD "B::PER.Set.simple AD:0x4003A004 %Long 0x67"
HISTory.Set CMD "B::PER.Set.Field AD:0x4003A008 %Long 0xFFFF 0x04"
HISTory.Set CMD "B::PER.Set.Field AD:0x4003A004 %Long 0xFFFF 0x05"
HISTory.Set CMD "B::PER.Set.Field AD:0x4003A008 %Long 0xFFFF 0xffff"
HISTory.Set CMD "B::PER.Set.Field AD:0x4003A008 %Long 0xFFFF 0x55"
HISTory.Set CMD "B::"
HISTory.Set CMD "B::V rotary_last_val_s = 2"
HISTory.Set CMD "B::PER.Set.Field AD:0x4003A004 %Long 0xFFFF 0"
HISTory.Set CMD "B::V heater_ctrl_s.req_temp = 300"
HISTory.Set CMD "B::V heater_ctrl_s.req_temp = 200"
HISTory.Set CMD "B::PER.Set.simple AD:0x4002C074 %Long 0x54"
HISTory.Set CMD "B::PER.Set.simple AD:0x4002C074 %Long 0x12345678"
HISTory.Set CMD "B::PER.Set.simple AD:0x4002C074 %Long 0x45"
HISTory.Set CMD "B::V rf_mgr_data_s.tx_payload[2] = 128"
HISTory.Set CMD "B::V rotary_count_s = 128"
HISTory.Set CMD "B::V rf_mgr_data_s.tx_payload[1] = 128"
HISTory.Set CMD "B::V pwm_value = 178"
HISTory.Set CMD "B::V rf_mgr_pwm_s = 0"
HISTory.Set CMD "B::V rf_mgr_pwm_s = 128"
HISTory.Set CMD "B::V rf_mgr_pwm_s = 30"
HISTory.Set CMD "B::V rf_mgr_pwm_s = 10"
HISTory.Set CMD "B::V rf_mgr_pwm_s = 45"
HISTory.Set CMD "B::V rf_mgr_pwm_s = 128"
HISTory.Set CMD "B::V rf_mgr_pwm_s = 0"
HISTory.Set CMD "B::V STEERING_control_data_s.raw_counts = 4090"
HISTory.Set CMD "B::V STEERING_control_data_s.neutral_trim = 3"
HISTory.Set CMD "B::V STEERING_control_data_s.neutral_trim = 20"
HISTory.Set CMD "B::V STEERING_control_data_s.neutral_trim = -20"
HISTory.Set CMD "B::V STEERING_control_data_s.neutral_trim = -15"
HISTory.Set CMD "B::V STEERING_control_data_s.neutral_trim = -10"
HISTory.Set CMD "B::V STEERING_control_data_s.neutral_trim = -5"
HISTory.Set CMD "B::V STEERING_control_data_s.neutral_trim = -2"
HISTory.Set CMD "B::V STEERING_control_data_s.neutral_trim = -1"
HISTory.Set CMD "B::V STEERING_control_data_s.neutral_trim = -2"
HISTory.Set CMD "B::V STEERING_control_data_s.raw_counts = 0"
HISTory.Set CMD "B::V rotary_count_s = 0"
HISTory.Set CMD "B::V rotary_count_s = 2000"
HISTory.Set CMD "B::V rotary_count_s = 0"
HISTory.Set CMD "B::V STEERING_control_data_s.neutral_trim = -3"
HISTory.Set CMD "B::V STEERING_control_data_s.neutral_trim = -10"
HISTory.Set CMD "B::V STEERING_control_data_s.neutral_trim = -20"
HISTory.Set CMD "B::V STEERING_control_data_s.neutral_trim = -15"
HISTory.Set CMD "B::V STEERING_control_data_s.neutral_trim = -20"
HISTory.Set CMD "B::"
HISTory.Set CMD "B::V STEERING_control_data_s.neutral_trim = -40"
HISTory.Set CMD "B::V STEERING_control_data_s.neutral_trim = -25"
HISTory.Set CMD "B::V STEERING_control_data_s.neutral_trim = -20"
HISTory.Set CMD "B::V STEERING_control_data_s.neutral_trim = 0"
HISTory.Set CMD "B::V STEERING_control_data_s.neutral_trim = 10"
HISTory.Set CMD "B::V STEERING_control_data_s.neutral_trim = 5"
HISTory.Set CMD "B::V STEERING_control_data_s.neutral_trim = -10"
HISTory.Set CMD "B::V STEERING_control_data_s.neutral_trim = 0"
HISTory.Set CMD "B::V STEERING_control_data_s.neutral_trim = -4"
HISTory.Set CMD "B::V STEERING_control_data_s.neutral_trim = 4"
HISTory.Set CMD "B::b"
HISTory.Set CMD "B::V STEERING_control_data_s.neutral_trim = 10"
HISTory.Set CMD "B::V STEERING_control_data_s.neutral_trim = -10"
HISTory.Set CMD "B::B::RunTime 0#"
HISTory.Set CMD "B::B::RunTime 0"
HISTory.Set CMD "B::B::RunTime=0"
HISTory.Set CMD "B::B::RunTime.RESet "
HISTory.Set FILE ":practice" "B::B::CD.DO C:\Users\marks\OneDrive\Desktop\Projects\S32K\Tool_cfg\Lauterbach\s32k144_flash.cmm" "C:\Users\marks\OneDrive\Desktop\Projects\S32K\tool_cfg\Lauterbach"
HISTory.Set FILE ":edit" "B::B::CD.PEDIT C:\Users\marks\OneDrive\Desktop\Projects\S32K\Tool_cfg\Lauterbach\s32k144_attach.cmm" "C:\Users\marks\OneDrive\Desktop\Projects\S32K\tool_cfg\Lauterbach"
HISTory.Set FILE ":practice" "B::B::CD.DO C:\SVN_source\Tools\Lauterbach\T32\demo\arm\hardware\s32k\s32k144\s32k144_sieve_flash.cmm" "C:\SVN_source\Tools\Lauterbach\T32\demo\arm\hardware\s32k\s32k144"
HISTory.Set FILE ":practice" "B::B::CD.DO C:\Users\marks\OneDrive\Desktop\Projects\S32K\Tool_cfg\Lauterbach\s32k144_attach.cmm" "C:\Users\marks\OneDrive\Desktop\Projects\S32K\tool_cfg\Lauterbach"
HISTory.Set FILE ":edit" "B::B::CD.PEDIT C:\Users\marks\OneDrive\Desktop\Projects\S32K\Tool_cfg\Lauterbach\s32k144_flash.cmm" "C:\Users\marks\OneDrive\Desktop\Projects\S32K\tool_cfg\Lauterbach"
HISTory.Set FILE ":edit" "B::B::CD.PEDIT C:\Users\marks\OneDrive\Desktop\Projects\HUB\Tool_cfg\Lauterbach\stm32f103_flash_and_debug.cmm" "C:\Users\marks\OneDrive\Desktop\Projects\HUB\Tool_cfg\Lauterbach"
HISTory.Set FILE ":edit" "B::B::CD.PEDIT C:\Users\marks\OneDrive\Desktop\Projects\HUB\Tool_cfg\Lauterbach\stm32f103_attach.cmm" "C:\Users\marks\OneDrive\Desktop\Projects\HUB\Tool_cfg\Lauterbach"
HISTory.Set FILE ":practice" "B::B::CD.DO C:\Users\marks\OneDrive\Desktop\Projects\HUB\Tool_cfg\Lauterbach\stm32f103_flash_and_debug.cmm" "C:\Users\marks\OneDrive\Desktop\Projects\HUB\Tool_cfg\Lauterbach"
HISTory.Set FILE ":practice" "B::B::CD.DO C:\Users\marks\OneDrive\Desktop\Projects\HUB\Tool_cfg\Lauterbach\ToolBar.men" "C:\Users\marks\OneDrive\Desktop\Projects\HUB\Tool_cfg\Lauterbach"
HISTory.Set FILE ":edit" "B::B::CD.PEDIT C:\Users\marks\OneDrive\Desktop\Projects\HUB\Tool_cfg\Lauterbach\ToolBar.men" "C:\Users\marks\OneDrive\Desktop\Projects\HUB\Tool_cfg\Lauterbach"
HISTory.Set HLL "STEERING_control_data_s.neutral_trim = -25"
HISTory.Set HLL "STEERING_control_data_s.neutral_trim = -20"
HISTory.Set HLL "STEERING_control_data_s.neutral_trim = 5"
HISTory.Set HLL "STEERING_control_data_s.neutral_trim = 0"
HISTory.Set HLL "STEERING_control_data_s.neutral_trim = -4"
HISTory.Set HLL "STEERING_control_data_s.neutral_trim = 4"
HISTory.Set HLL "a"
HISTory.Set HLL "b"
HISTory.Set HLL "STEERING_control_data_s.neutral_trim = 10"
HISTory.Set HLL "STEERING_control_data_s.neutral_trim = -10"
HISTory.Set ADDRESS "0x08000000"
HISTory.Set ADDRESS "AD:0x4002C064"
HISTory.Set ADDRESS "AD:0x4006A018"
HISTory.Set ADDRESS "AD:0x4006A010"
HISTory.Set ADDRESS "AD:0x4003A008"
HISTory.Set ADDRESS "AD:0x4003A004"
HISTory.Set ADDRESS "AD:0x4002C074"
HISTory.Set ADDRESS "0x1003F000"
HISTory.Set ADDRESS "0x00070000"
HISTory.Set ADDRESS "0x10000000"

BookMark.RESet

ENDDO
