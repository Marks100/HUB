; HUB project - STM32F103C8T6
; Attach to a running target without reset or reflash.
; Use this for live debugging after the target is already running.
;
; Flash layout (128 KB total - confirmed via live F_SIZE register read at 0x1FFFF7E0; this "C8"
; part is physically 128 KB silicon, a known STM32F103 binning quirk):
;   BM  : 0x08000000 - 0x08002BFF  11 KB
;   FBL : 0x08002C00 - 0x080077FF  19 KB
;   APP : 0x08007800 - 0x0801F7FF  96 KB  (vectors at 0x08007900)
;   NVM : 0x0801F800 - 0x0801FFFF   2 KB  (reserved, placed dynamically - page 1 (FBL's, fixed
;                                          base) via FLS_STM32F1_get_nvm_base_address(), page 2
;                                          (APP's) via APP's own app_nvm_page2_base_address())
;
; Required environment variables:
;   LAUTERBACH_APP_EXE  path to APP/Build/APP.elf
;   LAUTERBACH_BM_EXE   path to BM/Build/BM.elf

&app_exe=OS.ENV("LAUTERBACH_APP_EXE")
&bm_exe=OS.ENV("LAUTERBACH_BM_EXE")

; --------------------------------------------------------------------------------
; Attach without reset
SYStem.CPU STM32F103C8
SYStem.CONFIG.DEBUGPORTTYPE SWD
IF COMBIPROBE()||UTRACE()
(
  SYStem.CONFIG.CONNECTOR MIPI20T
)
SYStem.Option DUALPORT ON
SYStem.MemAccess DAP
SYStem.JtagClock 10MHz
SYStem.Option.IMASKHLL ON
SYStem.Option.IMASKASM ON
Trace.DISable
Mode.Hll
SYStem.Attach

; --------------------------------------------------------------------------------
; Load debug symbols from both partitions (no reflash)
Data.LOAD.auto &bm_exe  /nocode /noclear
Data.LOAD.auto &app_exe /nocode /noclear

; --------------------------------------------------------------------------------
; Open debug windows
List.auto
Frame.view
Register.view /SpotLight
setup.var.%Hex %Decimal %SpotLight %Index

Do ToolBar.men

ENDDO
