; HUB project - STM32F103C8T6
; Attach to a running target without reset or reflash.
; Use this for live debugging after the target is already running.
;
; Flash layout (128 KB total - confirmed via live F_SIZE register read at 0x1FFFF7E0; this "C8"
; part is physically 128 KB silicon, a known STM32F103 binning quirk):
;   BM  : 0x08000000 - 0x080027FF  10 KB
;   FBL : 0x08002800 - 0x08007FFF  22 KB
;   APP : 0x08008000 - 0x0801F7FF  94 KB  (vectors at 0x08008100)
;   NVM : 0x0801F800 - 0x0801FFFF   2 KB  (reserved - fixed by NVM_BASE_ADDRESS/NVM_TOTAL_SIZE in
;                                          Common_Src/PROJ_CONFIG/PROJ_config.h. NVM_GEN2's two
;                                          flip-flop partitions - A at 0x0801F800, B at 0x0801FC00,
;                                          shared by FBL and APP. Exactly one carries a committed
;                                          16-byte header; dump both and the higher seq wins. See
;                                          xCOMMON_MODULES/Src/NVM_GEN2/README.md)
;
; Required environment variables:
;   LAUTERBACH_APP_EXE  path to APP/Build/APP.elf
;   LAUTERBACH_BM_EXE   path to BM/Build/BM.elf

&app_exe=OS.ENV("LAUTERBACH_APP_EXE")
&bm_exe=OS.ENV("LAUTERBACH_BM_EXE")

; --------------------------------------------------------------------------------
; Attach without reset
; Uses STM32F103CB (128 KB part number), not C8 - this chip is a "C8" that's physically 128 KB
; silicon (see the binning quirk note above), and C8's device-database entry in Trace32 caps
; things at the nominal 64 KB. This script never writes flash, but keeping both .cmm files on the
; same device entry as stm32f103_flash_and_debug.cmm avoids reading/verifying against a
; different idea of the flash size than what was actually programmed.
SYStem.CPU STM32F103CB
SYStem.CONFIG.DEBUGPORTTYPE SWD
IF COMBIPROBE()||UTRACE()
(
  SYStem.CONFIG.CONNECTOR MIPI20T
)
SYStem.Option DUALPORT ON
SYStem.MemAccess DAP
SYStem.JtagClock 10MHz
SYStem.Option.IMASKHLL ON
SYStem.Option.IMASKASM ON
Trace.DISable
Mode.Hll
SYStem.Attach

; --------------------------------------------------------------------------------
; Load debug symbols from both partitions (no reflash)
Data.LOAD.auto &bm_exe  /nocode /noclear
Data.LOAD.auto &app_exe /nocode /noclear

; --------------------------------------------------------------------------------
; Open debug windows
List.auto
Frame.view
Register.view /SpotLight
setup.var.%Hex %Decimal %SpotLight %Index

Do ToolBar.men

ENDDO
